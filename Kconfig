## Kconfig
```kconfig
DT_COMPAT_ZMK_SPLIT_STATUS_RELAY := zmk,split-status-relay
config ZMK_SPLIT_STATUS_RELAY
    bool
    default $(dt_compat_enabled,$(DT_COMPAT_ZMK_SPLIT_STATUS_RELAY))
```

## central/Kconfig
```kconfig
DT_COMPAT_ZMK_SPLIT_STATUS_RELAY_CENTRAL := zmk,split-status-relay-central
config ZMK_SPLIT_STATUS_RELAY_CENTRAL
    bool
    default $(dt_compat_enabled,$(DT_COMPAT_ZMK_SPLIT_STATUS_RELAY_CENTRAL))
```

## central/dts/bindings/zmk,split-status-relay-central.yaml
```yaml
description: |
  Split status relay central

compatible: "zmk,split-status-relay-central"

properties:
  asdc-channel:
    type: phandle
    required: true
    description: The asdc channel to use.
```

## dts/bindings/zmk,split-status-relay.yaml
```yaml
description: |
  Split status relay

compatible: "zmk,split-status-relay"

properties:
  asdc-channel:
    type: phandle
    required: true
    description: The asdc channel to use.
```

## example_consumer/Kconfig
```kconfig
DT_COMPAT_ZMK_SPLIT_STATUS_RELAY_CONSUMER := zmk,split-status-relay-consumer
config ZMK_SPLIT_STATUS_RELAY_CONSUMER
		bool
		default $(dt_compat_enabled,$(DT_COMPAT_ZMK_SPLIT_STATUS_RELAY_CONSUMER))
```

## example_consumer/dts/bindings/zmk,split-status-relay-consumer.yaml
```yaml
description: |
  Allows defining split status relay consumer

compatible: "zmk,split-status-relay-consumer"

properties:
  ssrc:
    type: phandle
    required: true
    description: The split status relay to use.
```

## peripheral/Kconfig
```kconfig
DT_COMPAT_ZMK_SPLIT_STATUS_RELAY_PERIPHERAL := zmk,split-status-relay-peripheral
config ZMK_SPLIT_STATUS_RELAY_PERIPHERAL
    bool
    default $(dt_compat_enabled,$(DT_COMPAT_ZMK_SPLIT_STATUS_RELAY_PERIPHERAL))
```

## peripheral/dts/bindings/zmk,split-status-relay-peripheral.yaml
```yaml
description: |
  Split status relay peripheral

compatible: "zmk,split-status-relay-peripheral"

properties:
  asdc-channel:
    type: phandle
    required: true
    description: The asdc channel to use.
```
